## boards/shields/strix_piano/Kconfig.defconfig
```kconfig
if SHIELD_STRIX_PIANO_LEFT

# Name must be less than 16 characters long!
config ZMK_KEYBOARD_NAME
    default "Strix piano"

config ZMK_SPLIT_ROLE_CENTRAL
    default y

endif

if SHIELD_MY_KEYBOARD_LEFT || SHIELD_STRIX_PIANO_RIGHT

config ZMK_SPLIT
    default y

endif
```

## boards/shields/strix_piano/Kconfig.shield
```kconfig
# No whitespace after the comma or in your part name!
config SHIELD_STRIX_PIANO_LEFT
    def_bool $(shields_list_contains,strix_piano_left)

# No whitespace after the comma or in your part name!
config SHIELD_STRIX_PIANO_RIGHT
    def_bool $(shields_list_contains,strix_piano_right)
```
